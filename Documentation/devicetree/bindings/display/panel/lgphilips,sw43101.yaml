## Documentation/devicetree/bindings/opp/qcom-cpufreq-nvmem.yaml
```yaml
# SPDX-License-Identifier: (GPL-2.0-only OR BSD-2-Clause)
%YAML 1.2
---
$id: http://devicetree.org/schemas/opp/qcom-cpufreq-nvmem.yaml#
$schema: http://devicetree.org/meta-schemas/core.yaml#

title: Qualcomm Technologies, Inc. NVMEM CPUFreq and OPP bindings

maintainers:
  - Ilia Lin <ilia.lin@kernel.org>

description: |
  In Certain Qualcomm Technologies, Inc. SoCs like apq8096 and msm8996,
  the CPU frequencies subset and voltage value of each OPP varies based on
  the silicon variant in use.
  Qualcomm Technologies, Inc. Process Voltage Scaling Tables defines
  the voltage and frequency value based on the speedbin blown in the
  efuse combination.
  The qcom-cpufreq-nvmem driver reads the efuse value from the SoC to provide
  the OPP framework with required information (existing HW bitmap).
  This is used to determine the voltage and frequency value for each OPP of
  operating-points-v2 table when it is parsed by the OPP framework.

patternProperties:
  compatible:
    enum:
      - qcom,apq8096
      - qcom,msm8996
      - qcom,qcs404
      - qcom,ipq8064
      - qcom,apq8064
      - qcom,msm8974
      - qcom,msm8960

  '^opp-table(-[a-z0-9]+)?$':
    type: object

    patternProperties:
      compatible:
        const: operating-points-v2-kryo-cpu

      nvmem-cells:
        description: |
          A phandle pointing to a nvmem-cells node representing the
          efuse registers that has information about the
          speedbin that is used to select the right frequency/voltage
          value pair.

      opp-shared: true

      '^opp-?[0-9]+$':
        type: object

        properties:
          opp-hz: true
          opp-microvolt: true
          clock-latency-ns: true

          opp-supported-hw:
            description: |
              A single 32 bit bitmap value, representing compatible HW.
              Bitmap:
              0:  MSM8996, speedbin 0
              1:  MSM8996, speedbin 1
              2:  MSM8996, speedbin 2
              3-31:  unused

        required:
          - opp-hz
          - opp-supported-hw

allOf:
  - $ref: opp-v2-base.yaml#
  - if:
      properties:
        compatible:
          contains:
            const: qcom,qcs404
    then:
      patternProperties:
        cpus:
          type: object

          patternProperties:
            'cpu@[0-9a-f]+':
              type: object
 
              properties:
                power-domains:
                  items:
                    - description: A phandle pointing to the PM domain specifier
                        which provides the performance states available for active
                        state management.
                power-domain-names:
                  items:
                    - const: cpr

        '^opp-?[0-9]+$':
          properties:
            required-opps: true

          required:
            - opp-hz
            - opp-supported-hw
            - required-opps

unevaluatedProperties: false

examples:
  - |
    / {
        model = "Qualcomm Technologies, Inc. MSM8996";
        compatible = "qcom,msm8996";
        #address-cells = <2>;
        #size-cells = <2>;

        cpus {
            #address-cells = <2>;
            #size-cells = <0>;

            CPU0: cpu@0 {
                device_type = "cpu";
                compatible = "qcom,kryo";
                reg = <0x0 0x0>;
                enable-method = "psci";
                cpu-idle-states = <&CPU_SLEEP_0>;
                capacity-dmips-mhz = <1024>;
                clocks = <&kryocc 0>;
                operating-points-v2 = <&cluster0_opp>;
                #cooling-cells = <2>;
                next-level-cache = <&L2_0>;
                L2_0: l2-cache {
                    compatible = "cache";
                    cache-level = <2>;
                };
            };

            CPU1: cpu@1 {
                device_type = "cpu";
                compatible = "qcom,kryo";
                reg = <0x0 0x1>;
                enable-method = "psci";
                cpu-idle-states = <&CPU_SLEEP_0>;
                capacity-dmips-mhz = <1024>;
                clocks = <&kryocc 0>;
                operating-points-v2 = <&cluster0_opp>;
                #cooling-cells = <2>;
                next-level-cache = <&L2_0>;
            };

            CPU2: cpu@100 {
                device_type = "cpu";
                compatible = "qcom,kryo";
                reg = <0x0 0x100>;
                enable-method = "psci";
                cpu-idle-states = <&CPU_SLEEP_0>;
                capacity-dmips-mhz = <1024>;
                clocks = <&kryocc 1>;
                operating-points-v2 = <&cluster1_opp>;
                #cooling-cells = <2>;
                next-level-cache = <&L2_1>;
                L2_1: l2-cache {
                    compatible = "cache";
                    cache-level = <2>;
                };
            };

            CPU3: cpu@101 {
                device_type = "cpu";
                compatible = "qcom,kryo";
                reg = <0x0 0x101>;
                enable-method = "psci";
                cpu-idle-states = <&CPU_SLEEP_0>;
                capacity-dmips-mhz = <1024>;
                clocks = <&kryocc 1>;
                operating-points-v2 = <&cluster1_opp>;
                #cooling-cells = <2>;
                next-level-cache = <&L2_1>;
            };

            cpu-map {
                cluster0 {
                    core0 {
                        cpu = <&CPU0>;
                    };

                    core1 {
                        cpu = <&CPU1>;
                    };
                };

                cluster1 {
                    core0 {
                        cpu = <&CPU2>;
                    };

                    core1 {
                        cpu = <&CPU3>;
                    };
                };
            };
        };

        cluster0_opp: opp_table0 {
            compatible = "operating-points-v2-kryo-cpu";
            nvmem-cells = <&speedbin_efuse>;
            opp-shared;

            opp-307200000 {
                opp-hz = /bits/ 64 <307200000>;
                opp-supported-hw = <0x7>;
                clock-latency-ns = <200000>;
            };
            opp-422400000 {
                opp-hz = /bits/ 64 <422400000>;
                opp-supported-hw = <0x7>;
                clock-latency-ns = <200000>;
            };
            opp-480000000 {
                opp-hz = /bits/ 64 <480000000>;
                opp-supported-hw = <0x7>;
                clock-latency-ns = <200000>;
            };
            opp-556800000 {
                opp-hz = /bits/ 64 <556800000>;
                opp-supported-hw = <0x7>;
                clock-latency-ns = <200000>;
            };
            opp-652800000 {
                opp-hz = /bits/ 64 <652800000>;
                opp-supported-hw = <0x7>;
                clock-latency-ns = <200000>;
            };
            opp-729600000 {
                opp-hz = /bits/ 64 <729600000>;
                opp-supported-hw = <0x7>;
                clock-latency-ns = <200000>;
            };
            opp-844800000 {
                opp-hz = /bits/ 64 <844800000>;
                opp-supported-hw = <0x7>;
                clock-latency-ns = <200000>;
            };
            opp-960000000 {
                opp-hz = /bits/ 64 <960000000>;
                opp-supported-hw = <0x7>;
                clock-latency-ns = <200000>;
            };
            opp-1036800000 {
                opp-hz = /bits/ 64 <1036800000>;
                opp-supported-hw = <0x7>;
                clock-latency-ns = <200000>;
            };
            opp-1113600000 {
                opp-hz = /bits/ 64 <1113600000>;
                opp-supported-hw = <0x7>;
                clock-latency-ns = <200000>;
            };
            opp-1190400000 {
                opp-hz = /bits/ 64 <1190400000>;
                opp-supported-hw = <0x7>;
                clock-latency-ns = <200000>;
            };
            opp-1228800000 {
                opp-hz = /bits/ 64 <1228800000>;
                opp-supported-hw = <0x7>;
                clock-latency-ns = <200000>;
            };
            opp-1324800000 {
                opp-hz = /bits/ 64 <1324800000>;
                opp-supported-hw = <0x7>;
                clock-latency-ns = <200000>;
            };
            opp-1401600000 {
                opp-hz = /bits/ 64 <1401600000>;
                opp-supported-hw = <0x7>;
                clock-latency-ns = <200000>;
            };
            opp-1478400000 {
                opp-hz = /bits/ 64 <1478400000>;
                opp-supported-hw = <0x7>;
                clock-latency-ns = <200000>;
            };
            opp-1593600000 {
                opp-hz = /bits/ 64 <1593600000>;
                opp-supported-hw = <0x7>;
                clock-latency-ns = <200000>;
            };
        };

        cluster1_opp: opp_table1 {
            compatible = "operating-points-v2-kryo-cpu";
            nvmem-cells = <&speedbin_efuse>;
            opp-shared;

            opp-307200000 {
                opp-hz = /bits/ 64 <307200000>;
                opp-supported-hw = <0x7>;
                clock-latency-ns = <200000>;
            };
            opp-403200000 {
                opp-hz = /bits/ 64 <403200000>;
                opp-supported-hw = <0x7>;
                clock-latency-ns = <200000>;
            };
            opp-480000000 {
                opp-hz = /bits/ 64 <480000000>;
                opp-supported-hw = <0x7>;
                clock-latency-ns = <200000>;
            };
            opp-556800000 {
                opp-hz = /bits/ 64 <556800000>;
                opp-supported-hw = <0x7>;
                clock-latency-ns = <200000>;
            };
            opp-652800000 {
                opp-hz = /bits/ 64 <652800000>;
                opp-supported-hw = <0x7>;
                clock-latency-ns = <200000>;
            };
            opp-729600000 {
                opp-hz = /bits/ 64 <729600000>;
                opp-supported-hw = <0x7>;
                clock-latency-ns = <200000>;
            };
            opp-806400000 {
                opp-hz = /bits/ 64 <806400000>;
                opp-supported-hw = <0x7>;
                clock-latency-ns = <200000>;
            };
            opp-883200000 {
                opp-hz = /bits/ 64 <883200000>;
                opp-supported-hw = <0x7>;
                clock-latency-ns = <200000>;
            };
            opp-940800000 {
                opp-hz = /bits/ 64 <940800000>;
                opp-supported-hw = <0x7>;
                clock-latency-ns = <200000>;
            };
            opp-1036800000 {
                opp-hz = /bits/ 64 <1036800000>;
                opp-supported-hw = <0x7>;
                clock-latency-ns = <200000>;
            };
            opp-1113600000 {
                opp-hz = /bits/ 64 <1113600000>;
                opp-supported-hw = <0x7>;
                clock-latency-ns = <200000>;
            };
            opp-1190400000 {
                opp-hz = /bits/ 64 <1190400000>;
                opp-supported-hw = <0x7>;
                clock-latency-ns = <200000>;
            };
            opp-1248000000 {
                opp-hz = /bits/ 64 <1248000000>;
                opp-supported-hw = <0x7>;
                clock-latency-ns = <200000>;
            };
            opp-1324800000 {
                opp-hz = /bits/ 64 <1324800000>;
                opp-supported-hw = <0x7>;
                clock-latency-ns = <200000>;
            };
            opp-1401600000 {
                opp-hz = /bits/ 64 <1401600000>;
                opp-supported-hw = <0x7>;
                clock-latency-ns = <200000>;
            };
            opp-1478400000 {
                opp-hz = /bits/ 64 <1478400000>;
                opp-supported-hw = <0x7>;
                clock-latency-ns = <200000>;
            };
            opp-1555200000 {
                opp-hz = /bits/ 64 <1555200000>;
                opp-supported-hw = <0x7>;
                clock-latency-ns = <200000>;
            };
            opp-1632000000 {
                opp-hz = /bits/ 64 <1632000000>;
                opp-supported-hw = <0x7>;
                clock-latency-ns = <200000>;
            };
            opp-1708800000 {
                opp-hz = /bits/ 64 <1708800000>;
                opp-supported-hw = <0x7>;
                clock-latency-ns = <200000>;
            };
            opp-1785600000 {
                opp-hz = /bits/ 64 <1785600000>;
                opp-supported-hw = <0x7>;
                clock-latency-ns = <200000>;
            };
            opp-1824000000 {
                opp-hz = /bits/ 64 <1824000000>;
                opp-supported-hw = <0x7>;
                clock-latency-ns = <200000>;
            };
            opp-1920000000 {
                opp-hz = /bits/ 64 <1920000000>;
                opp-supported-hw = <0x7>;
                clock-latency-ns = <200000>;
            };
            opp-1996800000 {
                opp-hz = /bits/ 64 <1996800000>;
                opp-supported-hw = <0x7>;
                clock-latency-ns = <200000>;
            };
            opp-2073600000 {
                opp-hz = /bits/ 64 <2073600000>;
                opp-supported-hw = <0x7>;
                clock-latency-ns = <200000>;
            };
            opp-2150400000 {
                opp-hz = /bits/ 64 <2150400000>;
                opp-supported-hw = <0x7>;
                clock-latency-ns = <200000>;
            };
        };

        soc {
            #address-cells = <1>;
            #size-cells = <1>;

            qfprom: qfprom@74000 {
                compatible = "qcom,msm8996-qfprom", "qcom,qfprom";
                reg = <0x00074000 0x8ff>;
                #address-cells = <1>;
                #size-cells = <1>;

                speedbin_efuse: speedbin@133 {
                    reg = <0x133 0x1>;
                    bits = <5 3>;
                };
            };
        };
    };

  - |
    / {
        model = "Qualcomm Technologies, Inc. QCS404";
        compatible = "qcom,qcs404";
        #address-cells = <2>;
        #size-cells = <2>;

        cpus {
            #address-cells = <1>;
            #size-cells = <0>;

            cpu@100 {
                device_type = "cpu";
                compatible = "arm,cortex-a53";
                reg = <0x100>;
                enable-method = "psci";
                cpu-idle-states = <&CPU_SLEEP_0>;
                next-level-cache = <&L2_0>;
                #cooling-cells = <2>;
                clocks = <&apcs_glb>;
                operating-points-v2 = <&cpu_opp_table>;
                power-domains = <&cpr>;
                power-domain-names = "cpr";
            };

            cpu@101 {
                device_type = "cpu";
                compatible = "arm,cortex-a53";
                reg = <0x101>;
                enable-method = "psci";
                cpu-idle-states = <&CPU_SLEEP_0>;
                next-level-cache = <&L2_0>;
                #cooling-cells = <2>;
                clocks = <&apcs_glb>;
                operating-points-v2 = <&cpu_opp_table>;
                power-domains = <&cpr>;
                power-domain-names = "cpr";
            };

            cpu@102 {
                device_type = "cpu";
                compatible = "arm,cortex-a53";
                reg = <0x102>;
                enable-method = "psci";
                cpu-idle-states = <&CPU_SLEEP_0>;
                next-level-cache = <&L2_0>;
                #cooling-cells = <2>;
                clocks = <&apcs_glb>;
                operating-points-v2 = <&cpu_opp_table>;
                power-domains = <&cpr>;
                power-domain-names = "cpr";
            };

            cpu@103 {
                device_type = "cpu";
                compatible = "arm,cortex-a53";
                reg = <0x103>;
                enable-method = "psci";
                cpu-idle-states = <&CPU_SLEEP_0>;
                next-level-cache = <&L2_0>;
                #cooling-cells = <2>;
                clocks = <&apcs_glb>;
                operating-points-v2 = <&cpu_opp_table>;
                power-domains = <&cpr>;
                power-domain-names = "cpr";
            };
        };

        cpu_opp_table: cpu-opp-table {
            compatible = "operating-points-v2-kryo-cpu";
            opp-shared;

            opp-1094400000 {
                opp-hz = /bits/ 64 <1094400000>;
                required-opps = <&cpr_opp1>;
            };
            opp-1248000000 {
                opp-hz = /bits/ 64 <1248000000>;
                required-opps = <&cpr_opp2>;
            };
            opp-1401600000 {
                opp-hz = /bits/ 64 <1401600000>;
                required-opps = <&cpr_opp3>;
            };
        };

        cpr_opp_table: cpr-opp-table {
            compatible = "operating-points-v2-qcom-level";

            cpr_opp1: opp1 {
                opp-level = <1>;
                qcom,opp-fuse-level = <1>;
            };
            cpr_opp2: opp2 {
                opp-level = <2>;
                qcom,opp-fuse-level = <2>;
            };
            cpr_opp3: opp3 {
                opp-level = <3>;
                qcom,opp-fuse-level = <3>;
            };
        };

        soc {
            #address-cells = <1>;
            #size-cells = <1>;

            cpr: power-controller@b018000 {
                compatible = "qcom,qcs404-cpr", "qcom,cpr";
                reg = <0x0b018000 0x1000>;

                vdd-apc-supply = <&pms405_s3>;
                #power-domain-cells = <0>;
                operating-points-v2 = <&cpr_opp_table>;
            };
        };
    };
```
