## Documentation/devicetree/bindings/display/panel/lgphilips,sw43101.yaml
```yaml
# SPDX-License-Identifier: GPL-2.0
%YAML 1.2
---
$id: http://devicetree.org/schemas/display/panel/lgphilips,sw43101.yaml#
$schema: http://devicetree.org/meta-schemas/core.yaml#

title: LG.Philips SW43101 1080x1920 OLED panel

maintainers:
  - Yassine Oudjana <y.oudjana@protonmail.com>

allOf:
  - $ref: panel-common.yaml#

properties:
  compatible:
    const: lgphilips,sw43101

  port: true
  reg: true
  reset-gpios: true

required:
  - compatible
  - reg
  - reset-gpios

additionalProperties: false

examples:
  - |
    #include <dt-bindings/gpio/gpio.h>

    dsi {
        #address-cells = <1>;
        #size-cells = <0>;

    	  panel@0 {
    		    compatible = "lgphilips,sw43101";
    		    reg = <0>;

    		    reset-gpios = <&msmgpio 8 GPIO_ACTIVE_LOW>;

    		    port {
    			      panel_in: endpoint {
    				        remote-endpoint = <&dsi_out>;
    			      };
    		    };
    	  };
    };

...
```

## Documentation/devicetree/bindings/input/cypress,sf3155.yaml
```yaml
# SPDX-License-Identifier: (GPL-2.0 OR BSD-2-Clause)
%YAML 1.2
---
$id: http://devicetree.org/schemas/input/cypress,streetfighter.yaml#
$schema: http://devicetree.org/meta-schemas/core.yaml#

title: Cypress StreetFighter touchkey controller

allOf:
  - $ref: input.yaml#

properties:
  compatible:
    enum:
      - cypress,sf3155

  reg:
    maxItems: 1

  interrupts:
    maxItems: 1

  vdd-supply:
    description: VDD supply

  avdd-supply:
    description: AVDD supply

required:
  - compatible
  - reg
  - interrupts

additionalProperties: false

examples:
  - |
    #include <dt-bindings/input/input.h>
    #include <dt-bindings/interrupt-controller/irq.h>
    i2c {
        #address-cells = <1>;
        #size-cells = <0>;

        touchkey@28 {
                compatible = "cypress,sf3155";
                reg = <0x28>;
                interrupt-parent = <&msmgpio>;
                interrupts = <77 IRQ_TYPE_EDGE_FALLING>;
                avdd-supply = <&vreg_l6a_1p8>;
                vdd-supply = <&vdd_3v2_tp>;
                linux,keycodes = <KEY_BACK KEY_MENU>;
        };
    };
```
